## boards/shields/cosmo/Kconfig.defconfig
```kconfig
if SHIELD_COSMO_LEFT

config ZMK_KEYBOARD_NAME
    default "Cosmo"

config ZMK_SPLIT_ROLE_CENTRAL
    default y

endif # SHIELD_COSMO_LEFT

if SHIELD_COSMO_LEFT || SHIELD_COSMO_RIGHT

config ZMK_SPLIT
    default y

endif # SHIELD_COSMO_LEFT || SHIELD_COSMO_RIGHT
```
